## main/Kconfig.projbuild
```kconfig
menu "ESP Network Camera Configuration"

    config ESPCAM_WIFI_AP_SSID
        string "WiFi AP SSID for provisioning"
        default "ESPCam_Setup"
        help
            WiFi SSID (network name) for the access point during provisioning.

    config ESPCAM_WIFI_AP_PASSWORD
        string "WiFi AP password for provisioning"
        default "12345678"
        help
            WiFi password for the access point during provisioning.

    config ESPCAM_MQTT_BROKER_URL
        string "MQTT broker URL"
        default "mqtt://your-broker.com"
        help
            URL of the MQTT broker to connect to.

    config ESPCAM_DEVICE_SERIAL
        string "Device serial number"
        default "ESPCAM001"
        help
            Unique serial number for this camera device.

    config ESPCAM_HEARTBEAT_INTERVAL
        int "Heartbeat interval in seconds"
        default 180
        help
            Interval between heartbeat messages in seconds.

endmenu
```

## sdkconfig.defaults
```kconfig
# ESP32P4 Configuration for WiFi Remote (with ESP32C6 coprocessor)
CONFIG_IDF_TARGET="esp32p4"

# ESP WiFi Controller Target Configuration
CONFIG_ESP_WIFI_CONTROLLER_TARGET="esp32c6"

# WiFi Provisioning Settings
CONFIG_WIFI_PROV_SCAN_MAX_ENTRIES=16
CONFIG_WIFI_PROV_AUTOSTOP_TIMEOUT=30
CONFIG_WIFI_PROV_STA_ALL_CHANNEL_SCAN=y

# Device Configuration
CONFIG_ESPCAM_DEVICE_SERIAL="ESP32P4CAM001"
CONFIG_ESPCAM_MQTT_BROKER_URL="mqtt://iotdevices.site"
CONFIG_ESPCAM_HEARTBEAT_INTERVAL=30

# Partition Configuration
CONFIG_PARTITION_TABLE_CUSTOM=y
CONFIG_PARTITION_TABLE_CUSTOM_FILENAME="partitions.csv"
```
